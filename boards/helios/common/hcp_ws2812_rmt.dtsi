/*
 * HCP shared WS2812 binding - ESP32-C3 variant: one data line, driven by RMT.
 *
 * The C6 and C5 describe the same strip through Zephyr's worldsemi,ws2812-spi
 * (hcp_ws2812.dtsi), which is verified working on the C6. On the C3 that route
 * initialised cleanly and left the LED dark on two different boards, while the
 * previous firmware lit this very pin from the RMT peripheral - so the C3 binds the
 * strip to espressif,esp32-ws2812-rmt (modules/drivers/ws2812_rmt), whose bit cells
 * come from a hardware counter rather than from CPU timing.
 *
 * Why the other two are not switched over yet, stated rather than left implicit:
 * their RMT is a later hardware generation, and the channel-data register has a
 * different member name and a different number of channels per instance (C3
 * `data_ch[4]`, C5 `chndata[4]`, C6 `chndata[2]`). Making that compile is easy and
 * proving it is not possible without one of those boards on the bench, and a driver
 * that silently writes the wrong generation's register reports itself as a dead LED -
 * the exact symptom this whole exercise started from. So the driver refuses to build
 * for a part it does not describe, and this file is included by the C3 alone until
 * someone can measure the others.
 *
 * The alias is the name the application looks up, so nothing above the devicetree
 * knows or needs to know which of the two drivers is underneath.
 *
 * SPDX-License-Identifier: Apache-2.0
 */

#include <zephyr/dt-bindings/gpio/gpio.h>
#include <zephyr/dt-bindings/led/led.h>

/ {
	aliases {
		hcp-led-strip = &led_strip;
	};

	led_strip: led-strip {
		compatible = "espressif,esp32-ws2812-rmt";
		status = "okay";

		/* LED data. The same pin the old firmware drove with RMT. */
		data-gpios = <&gpio0 8 GPIO_ACTIVE_HIGH>;
		chain-length = <1>;

		/* RMT TX channel 0: nothing else on this board uses RMT. */
		espressif,rmt-channel = <0>;

		/* How this board's LED is wired, which the driver obeys rather than
		 * assumes: WS2812-class parts take green first. */
		color-mapping = <LED_COLOR_ID_GREEN
				 LED_COLOR_ID_RED
				 LED_COLOR_ID_BLUE>;
	};
};
