/*
 * HCP shared WS2812 binding: one data line, waveforms from RMT.
 *
 * The strip's data line is GPIO8 on all three Helios boards - the same pin the previous
 * firmware drove (_led(GPIO_NUM_8, 1)).
 *
 * The alias is what the application looks up, so nothing above the devicetree knows
 * which peripheral produces the waveform.
 *
 * SPDX-License-Identifier: Apache-2.0
 */

#include <zephyr/dt-bindings/gpio/gpio.h>
#include <zephyr/dt-bindings/led/led.h>

/ {
	aliases {
		hcp-led-strip = &led_strip;
	};

	led_strip: led-strip {
		compatible = "espressif,esp32-ws2812-rmt";
		status = "okay";

		data-gpios = <&gpio0 8 GPIO_ACTIVE_HIGH>;
		chain-length = <1>;

		/* RMT TX channel 0: nothing else on these boards uses RMT. */
		espressif,rmt-channel = <0>;

		/* The board states how its LED is wired; the driver obeys. */
		color-mapping = <LED_COLOR_ID_GREEN
				 LED_COLOR_ID_RED
				 LED_COLOR_ID_BLUE>;
	};
};
