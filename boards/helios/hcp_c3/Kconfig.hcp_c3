## lib/mqtt/Kconfig
```kconfig
# hcp::mqtt module Kconfig
# SPDX-License-Identifier: Apache-2.0

menuconfig HCP_MQTT
	bool "HCP MQTT service session"
	# The client-id and every topic prefix come from the device serial number.
	depends on HCP_NET && HCP_IDENTITY
	# MQTT runs over TCP. The rest of HCP needs no TCP at all (Modbus is serial,
	# DNS/mDNS are UDP), so the stack is not enabled anywhere else - without this
	# select, zsock_connect simply fails and every connection attempt errors out.
	select NET_TCP
	# imply, not select: MQTT_LIB selects NET_SOCKETS, so a select/imply from a
	# symbol that itself depends on NET_SOCKETS would be a dependency loop. This
	# way MQTT_LIB pulls NET_SOCKETS in for us.
	imply MQTT_LIB
	default y
	help
	  Keeps one MQTT connection alive on top of the Wi-Fi station link and reports
	  the session to hcp::provision, so the status LED can tell "Wi-Fi up but the
	  broker is not" (violet) from "everything up" (green). Built on Zephyr's own
	  socket MQTT library - no extra third-party dependency.

if HCP_MQTT

config HCP_MQTT_HOST
	string "default broker host (empty = wait for it to be learned at runtime)"
	default ""
	help
	  Dotted IPv4 or a hostname. The discovery layer (SSDP) overrides this at
	  runtime through hcp::mqtt::SetBroker() and it is then kept in storage, so
	  leave this empty unless the broker address is fixed.

config HCP_MQTT_PORT
	int "default broker port"
	default 1883

config HCP_MQTT_USER
	string "broker username (empty = connect without credentials)"
	help
	  Compiled in on purpose: the account is created by the user on their own
	  broker, so it is not provisioned over the air.

config HCP_MQTT_PASS
	string "broker password"

config HCP_MQTT_TOPIC_DIAGNOSTICS
	string "diagnostics topic suffix (published as <sn>/<this>)"
	default "diagnostics"
	help
	  The topic Home Assistant's solar_manager integration subscribes for its
	  diagnostics sensors (base_device.handle_diagnostics). It used to be "state",
	  a name this firmware invented: nothing on the other side listened to it, so the
	  heartbeat was published into the void while the 120 s clear timer on the
	  integration kept running down. Payload keys the integration reads are ssid,
	  rssi and led; unknown keys are ignored, so uptime/firmware/ota travel safely
	  alongside them.

config HCP_MQTT_TOPIC_CMD
	string "command topic suffix (subscribed as <sn>/<this>)"
	default "cmd"

config HCP_MQTT_MAX_ROUTES
	int "Number of topic suffixes a handler may be registered for"
	default 10
	help
	  The client subscribes to "<sn>/#" and "<sn>-K/#" and dispatches locally, so
	  this is how many handlers the application can register (Home Assistant uses one
	  per function: config, the modbus write channel, the relay channel, restart,
	  heartbeat, ...). A registration beyond this fails loudly at boot rather than
	  silently ignoring the topic.

	  The count is not free to guess: nine are in use - seven for the meter device
	  (config, control/cmd, control/restart, control/reconfig, control/led,
	  host/heartbeat, ota/start), one for <sn>/cmd and one for <sn>-K/control/cmd -
	  so two are headroom. The ESP32-C5 used to default this to 1 while its collector
	  was disabled, which was not a saving: it made the collector refuse to start.
	  One entry is 36 bytes (a 24-byte suffix, the callback, its user pointer and the
	  topic tree it belongs to).

config HCP_MQTT_MAX_INBOUND
	int "Largest inbound payload kept (bytes)"
	default 448 if BOARD_HCP_C5
	default 512
	help
	  Larger than the outbound limit on purpose: a config download carries a whole
	  JSON point table and the widest one in use (jkbms.json) is about 390 bytes.
	  Anything above this is consumed and discarded, so a too-small value shows up
	  as a warning in the log instead of a desynchronised stream.

config HCP_MQTT_TOPIC_ONLINE
	string "online topic suffix (published once per connect)"
	default "online"

config HCP_MQTT_FW_VERSION
	string "firmware version reported on the online topic"
	default APP_VERSION
	help
	  Defaults to the build's single version knob (CONFIG_APP_VERSION) so the
	  broker, the OTA check and the image header can never disagree; overriding
	  this separately would be a footgun.

config HCP_MQTT_KEEPALIVE_SEC
	int "keepalive interval (seconds)"
	default 30

config HCP_MQTT_DIAG_INTERVAL_SEC
	int "periodic diagnostics publish interval (seconds, 0 = event-driven only)"
	default 30
	help
	  Publishes the small JSON status document on <sn>/diagnostics while the session
	  is up. Two reasons it must stay well under 120: Home Assistant clears the
	  diagnostics and device data after 120 s without an update (CLEAR_INTERVAL in
	  plugins/base_device.py), and without a periodic message the device is silent on
	  the broker between events - which leaves the MQTT debug view empty and gives no
	  liveness signal.

config HCP_MQTT_CONNECT_TIMEOUT_MS
	int "how long to wait for CONNACK"
	default 10000

config HCP_MQTT_RETRY_BASE_MS
	int "first reconnect backoff step (ms)"
	default 1000

config HCP_MQTT_RETRY_CAP_MS
	int "reconnect backoff ceiling (ms)"
	default 30000

config HCP_MQTT_BUF_SIZE
	int "MQTT rx/tx buffer size (bytes)"
	default 512

config HCP_MQTT_STACK_SIZE
	int "session thread stack size"
	default 4096

endif
```

## lib/net/Kconfig
```kconfig
# hcp::net module Kconfig
# SPDX-License-Identifier: Apache-2.0

menuconfig HCP_NET
	bool "HCP networking (Wi-Fi station)"
	default y
	select NETWORKING
	select NET_IPV4
	select NET_DHCPV4
	select NET_L2_ETHERNET
	select NET_MGMT
	select NET_MGMT_EVENT
	select NET_MGMT_EVENT_INFO
	select NET_L2_WIFI_MGMT
	select WIFI
	select DNS_RESOLVER
	# esp32 Wi-Fi runtime essentials (else association/DHCP are flaky)
	select ESP32_WIFI_STA_AUTO_DHCPV4
	help
	  Wi-Fi station support. Enabled by default: networking is core to the
	  collector. Pulls the Zephyr net stack + esp_wifi driver (the board's
	  &wifi node is already status=okay). Heap/stack sizing lives in prj.conf.

if HCP_NET

config HCP_NET_DEMO
	bool "Bring-up: connect to the SSID below on boot and log status"
	default n

choice HCP_NET_SECURITY
	prompt "Wi-Fi security (bring-up demo)"
	default HCP_NET_SECURITY_AUTO

config HCP_NET_SECURITY_AUTO
	bool "WPA/WPA2/WPA3 auto-negotiate"

config HCP_NET_SECURITY_PSK
	bool "WPA2-PSK only"

config HCP_NET_SECURITY_SAE
	bool "WPA3-SAE only"

endchoice

config HCP_NET_SSID
	string "Bring-up Wi-Fi SSID (for the demo connect)"
	default ""

config HCP_NET_PSK
	string "Bring-up Wi-Fi PSK (empty = open)"
	default ""

endif
```

## lib/provision/Kconfig
```kconfig
# hcp::provision module Kconfig
# Copyright (c) 2026 maybetaken
# SPDX-License-Identifier: Apache-2.0

menuconfig HCP_PROVISION
	bool "HCP provisioning state machine (credentials, LED, button)"
	default y
	depends on BLUFI && HCP_NET && HCP_STORAGE && HCP_INPUT
	help
	  Owns the boot policy around connectivity: try the credentials saved in
	  hcp::storage, fall back to BluFi when they do not work, persist what the
	  phone provisions, close BLE after success, show the state on the status LED
	  and act on the user button (short press = reboot, long press = forget
	  credentials). The transition logic (lib/provision/src/fsm.cpp) is pure and
	  covered by the host tests.

if HCP_PROVISION

config HCP_PROVISION_LED_BRIGHTNESS
	int "status LED brightness (percent)"
	range 1 100
	default 10
	help
	  Global scale applied to the status palette by hcp::led::Strip::SetBrightness().
	  The palette itself is authored at full 8-bit scale, so this single knob dims
	  every state. The LED sits on for half of each blink cycle, so 10 is already
	  clearly visible in a normal room; raise it for a panel-mounted enclosure.

config HCP_PROVISION_BAKEIN_SSID
	string "network to join when storage holds no credentials (bench / factory)"
	default ""
	help
	  Pre-provisioning. With both these empty - the default, and what ships - a device
	  with nothing in storage waits for a phone over BluFi. Set them and the first
	  boot instead joins this network and writes the pair into storage, so from then
	  on it behaves like any provisioned device (the phone, the button and Home
	  Assistant can all still replace it).

	  The passphrase is compiled into the image: anyone with the binary has the
	  network key. It is therefore only ever meant to come from an untracked conf
	  fragment - build.sh folds wificreds.conf (gitignored) into the build - and the
	  build directory carries _wifi so such an image cannot be mistaken for the
	  shipping one.

config HCP_PROVISION_BAKEIN_PSK
	string "passphrase for that network (empty = open network)"
	default ""

endif
```

## lib/registry/Kconfig
```kconfig
# hcp::registry module Kconfig
# SPDX-License-Identifier: Apache-2.0
menuconfig HCP_REGISTRY
	bool "HCP registry (Modbus point table, downloaded config, persistence)"
	default y
	help
	  The point table the collector polls: what to read, from which slave, how
	  often, and where to report it. Holds the rules for a table downloaded from
	  Home Assistant (a re-download always wins, only a change is persisted, a
	  payload with no segments array is ignored) and its serialized form in
	  hcp::storage. Pure logic - no kernel, no hardware - so the rules are covered
	  by the host test suite.

if HCP_REGISTRY

endif
```

## lib/storage/Kconfig
```kconfig
# hcp::storage module Kconfig
# SPDX-License-Identifier: Apache-2.0

menuconfig HCP_STORAGE
	bool "HCP key/value storage"
	default y

if HCP_STORAGE

choice HCP_STORAGE_BACKEND
	prompt "storage backend"
	default HCP_STORAGE_BACKEND_ZEPHYR if SETTINGS
	default HCP_STORAGE_BACKEND_POSIX

config HCP_STORAGE_BACKEND_ZEPHYR
	bool "Zephyr settings"
	depends on SETTINGS

config HCP_STORAGE_BACKEND_POSIX
	bool "POSIX filesystem (host tests)"

endchoice

config HCP_STORAGE_MAX_KEYS
	int "Max cached keys"
	default 16

config HCP_STORAGE_MAX_VALUE
	int "Max value size (bytes)"
	default 64

config HCP_STORAGE_KEY_MAX
	int "Max key length"
	default 16

endif
```

## lib/switch/Kconfig
```kconfig
# hcp::switchctl module Kconfig
# Copyright (c) 2026 maybetaken
# SPDX-License-Identifier: Apache-2.0

menuconfig HCP_SWITCH
	bool "HCP relay switch control (K1/K2)"
	default y
	depends on GPIO

if HCP_SWITCH

config HCP_ENABLE_SWITCH_CONTROL
	bool "Compile relay control into the application logic"
	default y
	help
	  Speaks the "<sn>-K" contract with Home Assistant: accepts
	  <sn>-K/control/cmd, drives hcp-k1/hcp-k2, keeps their state across a reboot
	  and reports it on <sn>-K/notify, and announces the device with its
	  switch_count on every connect. This is the shape of the previous firmware's
	  CONFIG_ENABLE_SWITCH_CONTROL path (main/solar_manager.cpp:108-122 plus
	  components/switch_ctrl), which is what the integration in the field expects.

	  Off on a board whose relays are not wired: the relay outputs are real pins on
	  every Helios board, so turning this off is a statement about a build, not
	  about hardware.

endif
```

## lib/transport/serial/Kconfig
```kconfig
# hcp::serial module Kconfig
# SPDX-License-Identifier: Apache-2.0

menuconfig HCP_SERIAL
	bool "HCP serial transport (modbus UART)"
	default y
	depends on SERIAL

if HCP_SERIAL

config HCP_SERIAL_UART_BAUD
	int "Default modbus UART baud"
	default 115200

config HCP_SERIAL_LOOPBACK_TEST
	bool "Run a TX->RX loopback self-test on the modbus UART"
	default n
	help
	  Bring-up aid: repeatedly writes a pattern to the hcp-uart and reads it
	  back. Short the port's TX and RX pins (e.g. c6 TTL: GPIO22<->GPIO23) to
	  verify the physical serial path without any Modbus slave attached.

config HCP_RTU_PROBE
	bool "Bench: send one raw Modbus RTU request and hexdump the reply"
	default n
	help
	  Goes straight through hcp::serial::Port, bypassing Zephyr's modbus subsys,
	  because the subsys rejects a CRC-failing reply before it logs anything - so
	  when a real slave answers but the frame is refused, there is no way to see
	  what actually arrived. This prints it.

	  Owns the uart1 pins: do not run it with hcp::collector enabled (two masters
	  on one bus), which is why it has no default and is not part of HCP_BENCH.

config HCP_RTU_PROBE_REQUEST
	string "request frame to send, as hex characters (CRC appended by the probe)"
	depends on HCP_RTU_PROBE
	default "01040001000C"
	help
	  CRC is appended by the probe. The default asks unit 1 for 12 input
	  registers starting at 1 - the first segment Home Assistant publishes for
	  the meter on the bench.

endif
```
