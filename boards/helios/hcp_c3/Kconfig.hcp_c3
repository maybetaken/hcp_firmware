## boards/helios/hcp_c3/Kconfig.hcp_c3
```kconfig
# HCP ESP32-C3 board configuration
# Copyright (c) 2026 maybetaken
# SPDX-License-Identifier: Apache-2.0

config BOARD_HCP_C3
	select SOC_ESP32C3_WROOM_02_N4
```

## boards/helios/hcp_c3/board.yml
```yaml
board:
  name: hcp_c3
  full_name: Helios Collector Platform (ESP32-C3)
  vendor: helios
  socs:
  - name: esp32c3
```

## boards/helios/hcp_c5/Kconfig.hcp_c5
```kconfig
# HCP ESP32-C5 board configuration
# Copyright (c) 2026 maybetaken
# SPDX-License-Identifier: Apache-2.0

config BOARD_HCP_C5
	select SOC_ESP32_C5_WROOM_1_N8R4
	select SOC_ESP32C5_HPCORE if BOARD_HCP_C5_ESP32C5_HPCORE
	select SOC_ESP32C5_LPCORE if BOARD_HCP_C5_ESP32C5_LPCORE
```

## boards/helios/hcp_c5/board.yml
```yaml
board:
  name: hcp_c5
  full_name: Helios Collector Platform (ESP32-C5)
  vendor: helios
  socs:
  - name: esp32c5
```

## boards/helios/hcp_c6/Kconfig.hcp_c6
```kconfig
# HCP ESP32-C6 board configuration
# SPDX-License-Identifier: Apache-2.0

config BOARD_HCP_C6
	select SOC_ESP32_C6_WROOM_1U_N8
	select SOC_ESP32C6_HPCORE if BOARD_HCP_C6_ESP32C6_HPCORE
	select SOC_ESP32C6_LPCORE if BOARD_HCP_C6_ESP32C6_LPCORE
```

## boards/helios/hcp_c6/board.yml
```yaml
board:
  name: hcp_c6
  full_name: Helios Collector Platform (ESP32-C6)
  vendor: helios
  socs:
  - name: esp32c6
```

## lib/collector/Kconfig
```kconfig
# hcp::collector module Kconfig
# SPDX-License-Identifier: Apache-2.0
menuconfig HCP_COLLECTOR
	bool "HCP collector (one queue, one worker: config, polling, reporting)"
	default y
	depends on HCP_MQTT && HCP_REGISTRY && HCP_STORAGE && HCP_MODBUS
	help
	  The business loop between Home Assistant and the Modbus bus: inbound topics
	  are routed onto one queue and acted on by one worker thread, which is the
	  only thread touching the bus and the point table. Replaces the old split
	  where a polling task published to MQTT inside the hardware mutex.

	  This fits the ESP32-C5 by 5,536 bytes of SRAM (372,848 of 378,384, 98.5 %),
	  and only because the P0 boot self-test was removed - enabling it used to
	  overflow by 6,288 bytes. Two things that leaves unsaid at link time: the C5
	  worker stack is 2,048 B and its high-water mark has never been measured on
	  real hardware (no C5 at the bench), and any future static allocation on that
	  board now needs the same arithmetic done again.

if HCP_COLLECTOR

config HCP_COLLECTOR_TICK_MS
	int "Worker wake-up interval (ms)"
	default 200
	help
	  How long the worker waits for a message before returning to its periodic
	  work (the poll schedule). Also the worst-case added latency of a command.

config HCP_COLLECTOR_QUEUE_DEPTH
	int "Queue depth (messages)"
	default 4 if BOARD_HCP_C5
	default 6

config HCP_COLLECTOR_SLOTS
	int "Payload buffers (one per in-flight message)"
	default 2 if BOARD_HCP_C5
	default 3

config HCP_COLLECTOR_MAX_MSG
	int "Largest payload kept (bytes)"
	default 512
	help
	  Matches the MQTT module's inbound limit; a config download with several
	  segments is a few hundred bytes of JSON.

config HCP_COLLECTOR_POLL_MS
	int "Milliseconds between two polls of the same segment"
	default 2000
	help
	  Every segment in the point table is read once per this period, staggered so a
	  multi-slave bus does not answer everything in the same tick. This replaces the
	  previous firmware's "one segment per second" round-robin, whose real purpose
	  was bounding the bus time per cycle; the schedule in schedule.cpp does that
	  explicitly now, and a dead slave additionally gets a 30 s backoff so it cannot
	  eat every cycle with its timeout.

config HCP_COLLECTOR_STACK_SIZE
	int "Worker stack size"
	default 2048 if BOARD_HCP_C5
	default 4096
	help
	  Sized for the deepest call on this thread (JSON parse, then a settings write
	  through hcp::storage). The ESP32-C5 variant is smaller because that board's
	  SRAM is the tightest of the three - its high-water mark has to be checked on
	  real hardware with the thread analyzer before it can be called comfortable.

endif
```

## lib/input/Kconfig
```kconfig
# hcp::input module Kconfig
# Copyright (c) 2026 maybetaken
# SPDX-License-Identifier: Apache-2.0

menuconfig HCP_INPUT
	bool "HCP input (button, debounced GPIO interrupt)"
	default y
	depends on GPIO
	help
	  User button on the devicetree `sw0` alias. The pin interrupts on both edges
	  and the line is sampled once the contact has stopped bouncing, so an idle
	  device runs nothing for the button (it used to poll every 5 ms). No wakeup
	  source: this collector does not sleep.

if HCP_INPUT

config HCP_INPUT_DEBOUNCE_MS
	int "Debounce settle time (ms)"
	default 30
	help
	  Both the window an edge waits before the pin is sampled again and the time a
	  level must hold before it is reported as settled (Debouncer). 30 ms is well
	  below what a hand can produce and well above typical contact bounce.

endif
```

## lib/kernel/Kconfig
```kconfig
# hcp::kernel module Kconfig
# SPDX-License-Identifier: Apache-2.0

menuconfig HCP_KERNEL
	bool "HCP kernel abstraction (thread/mutex/msgq/timer/time)"
	default y
	help
	  Backend-agnostic wrapper over OS primitives. On-target uses the
	  Zephyr backend; host unit tests compile the posix backend directly.

if HCP_KERNEL

choice
	prompt "kernel backend"
	default HCP_KERNEL_BACKEND_ZEPHYR

config HCP_KERNEL_BACKEND_ZEPHYR
	bool "Zephyr"

endchoice

config HCP_KERNEL_THREAD_STACK_SIZE
	int "Default dynamic thread stack size (bytes)"
	default 2048

config HCP_KERNEL_MAX_THREADS
	int "Static pool size for dynamically created threads"
	default 8

endif
```

## lib/led/Kconfig
```kconfig
# hcp::led module Kconfig
# SPDX-License-Identifier: Apache-2.0

menuconfig HCP_LED
	bool "HCP LED strip (WS2812-class)"
	default y
	help
	  Addressable LED strip support. The WS2812 node is in the shared board
	  devicetree (boards/helios/common/hcp_ws2812.dtsi) because the LED is present
	  on all Helios boards; this option decides only whether the application drives
	  it, and the backend below decides through what. To drop the driver from the
	  binary as well, disable what it selects (LED_STRIP, LED_STRIP_ESP_RMT).

if HCP_LED

choice HCP_LED_BACKEND
	prompt "LED backend"
	default HCP_LED_BACKEND_ZEPHYR

config HCP_LED_BACKEND_ZEPHYR
	bool "Zephyr led_strip API on the hcp-led-strip alias"
	select LED_STRIP
	help
	  The strip is whatever the board's devicetree binds to the hcp-led-strip alias -
	  the espressif,esp32-ws2812-rmt driver (modules/drivers/ws2812_rmt) on all three
	  Helios boards. No bus dependency comes from here: a driver's own Kconfig brings
	  its bus, and a board should not link a controller it cannot use.

config HCP_LED_BACKEND_POSIX
	bool "POSIX framebuffer (host tests)"

endchoice

endif
```

## lib/log/Kconfig
```kconfig
# hcp::log module Kconfig
# SPDX-License-Identifier: Apache-2.0

menuconfig HCP_LOG
	bool "HCP domain logging"
	default y

if HCP_LOG

choice
	prompt "log backend"
	default HCP_LOG_BACKEND_ZEPHYR

config HCP_LOG_BACKEND_ZEPHYR
	bool "Zephyr LOG"
	depends on LOG

config HCP_LOG_BACKEND_POSIX
	bool "POSIX (host tests)"

endchoice

menu "Per-domain log level (0=off 1=err 2=warn 3=info 4=dbg)"

config HCP_LOG_LEVEL_WIFI
	int "wifi domain level"
	default 3

config HCP_LOG_LEVEL_MQTT
	int "mqtt domain level"
	default 3

config HCP_LOG_LEVEL_MODBUS
	int "modbus domain level"
	default 3

config HCP_LOG_LEVEL_DEVICE
	int "device domain level"
	default 3

config HCP_LOG_LEVEL_OTA
	int "ota domain level"
	default 3

config HCP_LOG_LEVEL_SSDP
	int "ssdp domain level"
	default 3

endmenu

endif
```

## lib/modbus/Kconfig
```kconfig
# hcp::modbus module Kconfig
# Copyright (c) 2026 maybetaken
# SPDX-License-Identifier: Apache-2.0
menuconfig HCP_MODBUS
	bool "HCP Modbus RTU master"
	default y
	depends on SERIAL
	select MODBUS if HCP_MODBUS_BACKEND_SUBSYS
	select GPIO
	help
	  C++ facade over an RTU client, on the UART the board's `zephyr,modbus-serial`
	  node names - which also carries the RS485 DE pin. No third-party Modbus
	  implementation is involved either way.

	  MODBUS is only selected when the subsys backend is chosen on purpose: its
	  modbus_serial driver instantiates for the same devicetree node and would claim
	  the UART and the DE pin at init even when nothing calls it.

if HCP_MODBUS

choice HCP_MODBUS_BACKEND
	prompt "RTU framing backend"
	default HCP_MODBUS_BACKEND_NATIVE

config HCP_MODBUS_BACKEND_SUBSYS
	bool "Zephyr's in-tree subsys/modbus"
	help
	  The subsys owns RTU framing, t3.5 inter-frame timing and the DE line.

	  Not the default, and it is not a preference: on the bench meter it refused
	  every reply although a raw read of the same wire showed a CRC-perfect frame each
	  time (see rtu.h for the measurements), and it logs nothing about the bytes it
	  rejected. It stays selectable because no board but the C3 has been run with
	  hardware attached, so if the subsys turns out to work for another slave, that is
	  a measured fact to compare against rather than an assumption.

	  If you choose it, prj.conf must also assign CONFIG_MODBUS_ROLE_CLIENT=y (a
	  choice symbol cannot be selected from another symbol); CMake stops the build
	  with that instruction if it is missing.

config HCP_MODBUS_BACKEND_NATIVE
	bool "hcp's own RTU frame engine over hcp::serial::Port"
	depends on HCP_SERIAL
	help
	  Frames a reply by the length its REQUEST implies, under one overall deadline,
	  and prints the bytes it rejected. Ported behaviour from the previous firmware's
	  master (esp-mb's portserial.c: flush the receiver, then read a length that is
	  known rather than guessed from line idle).

	  The default on every board. See include/hcp/modbus/rtu.h for the measurements
	  that decided it; the C3 is the board where that was proven with a real slave.

endchoice

comment "The role choice (MODBUS_ROLE_CLIENT) is set in prj.conf: Kconfig"
comment "choices cannot be selected from a symbol like this one."

config HCP_MODBUS_DEFAULT_BAUD
	int "Default modbus baud"
	default 9600

config HCP_MODBUS_TIMEOUT_MS
	int "Milliseconds to wait for a slave's reply"
	default 500
	help
	  Passed to Zephyr's subsys as rx_timeout (in microseconds). Long enough for a
	  meter to answer at 9600 baud, short enough that one absent slave costs half a
	  second and not more - and after three such costs in a row the collector leaves
	  that unit alone for a cooldown (see hcp::collector::BusHealth).

config HCP_MODBUS_DEMO
	bool "Run a periodic Modbus poll demo in main"
	default n
	help
	  Bring-up aid: periodically reads holding registers from a configured
	  slave so the uart1/RS485 path can be exercised on real hardware. With no
	  slave on the bus it logs a -ENOTCONN per attempt, which still proves the
	  interface resolved, the UART is configured and DE toggles.

	  NOT implied by HCP_BENCH, and that is a measured correction rather than a
	  preference: hcp::collector also opens uart1, and with the demo on the bench
	  image both were running as masters on one half-duplex bus - the demo's
	  "poll failed (err=-116)" every 2 s buried the collector's own poll attempts
	  and made the bus unusable to observe. The question this demo used to answer
	  ("does the RTU path work?") is now answered better by publishing a point table
	  on <sn>/config over MQTT and watching the collector.

	  Do not combine it with hcp::collector, nor with the raw loopback self-test:
	  all three want the same pins.

config HCP_MODBUS_DEMO_SLAVE
	int "Demo: Modbus slave/unit address"
	default 1

endif
```
