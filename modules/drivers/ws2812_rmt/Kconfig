## modules/drivers/ws2812_rmt/Kconfig
```kconfig
# WS2812-over-RMT driver for ESP32 parts (Zephyr module)
# SPDX-License-Identifier: Apache-2.0

config LED_STRIP_ESP_RMT
	bool "WS2812 LED strip over the ESP32 RMT peripheral"
	depends on DT_HAS_ESPRESSIF_ESP32_WS2812_RMT_ENABLED
	select LED_STRIP
	default y
	help
	  Drives WS2812-class addressable LEDs through an RMT TX channel, behind
	  Zephyr's standard led_strip API. Enabled by having a node with compatible
	  "espressif,esp32-ws2812-rmt" in the devicetree; no board has to name a
	  Kconfig symbol to get it.

	  This exists because Zephyr ships no led_strip driver for Espressif RMT, and
	  because CPU bit-banging cannot hold the WS2812 phase widths on these parts:
	  measured on an ESP32-C3, a GPIO store costs 312 ns and a system-clock read
	  687 ns against a 400 ns phase, so the loop's own instrumentation is coarser
	  than what it has to control. RMT generates the waveforms from a hardware
	  counter and needs no interrupt blackout across a frame.

config WS2812_RMT_PROBE
	bool "Ask this part how an RMT TX frame is ended, once at boot"
	depends on LED_STRIP_ESP_RMT
	default n
	help
	  Runs a sequence of candidate frame-end settings through one test frame at
	  driver init and logs what the hardware answered for each. Meant for bringing
	  the driver up on a part it has not run on before, where "the two register
	  generations look the same in the ll layer but are not" is a question for the
	  silicon rather than for a header file.

	  Costs a few dozen milliseconds at boot and about ten log lines. Leave off for
	  anything else.
```

## modules/drivers/ws2812_rmt/dts/bindings/led_strip/espressif,esp32-ws2812-rmt.yaml
```yaml
# Copyright SPDX-License-Identifier: Apache-2.0
description: |
  WS2812-class addressable LEDs driven by an ESP32 RMT TX channel.

  Each data bit becomes one RMT symbol whose high time is the WS2812 phase
  (t0H 400 ns, t1H 800 ns of a 1250 ns bit), generated by the peripheral's own
  counter rather than by CPU timing. See ws2812_rmt.c for why that distinction is
  the reason this driver exists.

  Example:

    led_strip0: led-strip {
            compatible = "espressif,esp32-ws2812-rmt";
            data-gpios = <&gpio0 8 GPIO_ACTIVE_HIGH>;
            chain-length = <1>;
    };

compatible: "espressif,esp32-ws2812-rmt"

include: ws2812.yaml

properties:
  data-gpios:
    type: phandle-array
    required: true
    description: |
      GPIO driving the strip's data line. It is configured as an output and then
      routed to through the GPIO matrix by the RMT signal of the chosen channel, so
      no pinmux table entry is needed - the pin number is free within the part's
      matrix.

  espressif,rmt-channel:
    type: int
    default: 0
    description: |
      RMT TX channel to use. This driver claims exactly one channel per DT instance
      and allocates none, so two strip nodes have to name different channels
      explicitly - and the channel must exist on the part (four on the ESP32-C3,
      fewer on some newer ones), which the binding cannot know.
```

## modules/lib/blufi/Kconfig
```kconfig
# Copyright (c) 2026 maybetaken
# SPDX-License-Identifier: Apache-2.0

# BluFi module Kconfig
menuconfig BLUFI
	bool "BluFi BLE provisioning protocol (ESP BluFi compatible)"
	default n
	select BT
	select BT_PERIPHERAL
	select BT_DRIVERS
	select BT_ESP32
	help
	  Reusable BluFi protocol implementation: the frame codec plus the GATT
	  transport and security handshake on Zephyr BLE, compatible with the Espressif
	  apps and the WeChat mini-program provisioning flow.

if BLUFI

config BLUFI_STRICT_SEQ
	bool "Reject a frame whose sequence number is out of order"
	default y
	help
	  ESP-IDF's receiver tracks recv_seq, refuses a frame whose seq is not the expected
	  next one, and reports SEQUENCE_ERROR on DATA/ERROR_INFO. On (the default) matches
	  that, so a phone that sent a frame twice, or a frame that arrived out of order, is
	  told so instead of being acted on twice.

	  Off accepts the frame anyway, at the cost of diverging from upstream: only worth
	  it while debugging a client that restarts its sequence without reconnecting.

config BLUFI_SECURITY
	bool "BluFi security handshake (DH + AES-CFB128 + MD5)"
	default n
	help
	  Enables the ESP-compatible BluFi key negotiation (Diffie-Hellman) and
	  AES-128-CFB128 payload encryption used when the phone app selects
	  encrypted provisioning.

	  The algorithms are not part of this repository: they are the Mbed TLS
	  2.28 LTS sources checked out by the west manifest (dhm, bignum, aes and
	  md5, unmodified; AES with its symbols renamed at compile time because the
	  application already links an AES of its own). If that module is not
	  present the build fails with instructions rather than silently compiling a
	  copy - point -DBLUFI_MBEDTLS_DIR at a checkout if your layout differs.

	  Left off by default: plaintext provisioning interoperates with both the
	  Espressif apps and the WeChat mini-program, and what this handshake adds is
	  protocol compatibility rather than strength - its DH group is 256 bits and
	  the key is MD5-derived.

config BLUFI_BLE_SUPERVISION_TIMEOUT
	int "Supervision timeout to request for the link (10 ms units, 0 = central's choice)"
	default 0
	depends on BLUFI
	help
	  A Wi-Fi scan or association burst deafens the ESP32's shared 2.4 GHz
	  radio to BLE for seconds; against centrals that negotiated a short
	  supervision timeout the link then drops (reason 8, supervision
	  timeout) mid-provisioning and the phone never receives the final
	  report. Set this (600 = 6 s, the Apple guideline maximum) to request
	  a timeout that survives the radio gap; the central may still refuse.
	  0 keeps whatever the central negotiated.

endif
```

## modules/lib/nanomodbus/Kconfig
```kconfig
# nanoMODBUS module Kconfig
config NANOMODBUS
	bool "nanoMODBUS Modbus RTU/TCP library"
	default y
	help
	  nanoMODBUS (https://github.com/debevv/nanoMODBUS, MIT) exposed as a Zephyr
	  module so it can be reused across projects. Provides the Modbus protocol
	  implementation that the application's master wrapper builds on; the library
	  itself is transport-agnostic, so the caller supplies the read/write
	  functions that touch the UART or socket.
```

## modules/lib/ota_client/Kconfig
```kconfig
# ota_client module Kconfig
#
# Copyright (c) 2026 the ota_client authors
# SPDX-License-Identifier: MIT

menuconfig OTA_CLIENT
	bool "Firmware update client (transport agnostic)"
	help
	  Applies an update policy over two small operation tables: a source of
	  image bytes (HTTP today, anything else can be added by the user) and a
	  sink that stages them for the bootloader (MCUboot today). The core has no
	  dependency on a board, an application or a cloud service.

if OTA_CLIENT

config OTA_CLIENT_ALLOW_DOWNGRADE
	bool "Accept any version difference, including downgrades"
	default n
	help
	  By default an image is only fetched when its version is strictly newer
	  than the running one. Enable this to also accept an older image, which is
	  useful for factory re-flows but turns "check" into "always download".

config OTA_CLIENT_VERSION_MAX_LEN
	int "Maximum length of a version string"
	default 32

config OTA_CLIENT_URL_MAX_LEN
	int "Maximum length of an URL"
	default 128

config OTA_CLIENT_SOURCE_HTTP
	bool "HTTP(S) image source"
	default y
	select HTTP_CLIENT
	help
	  Streams an image from a plain HTTP server. No TLS: authenticity and
	  integrity are the bootloader's job (MCUboot validates the image
	  signature), and transport encryption is a deployment decision. The
	  source can be replaced by the application without touching the core.

if OTA_CLIENT_SOURCE_HTTP

config OTA_CLIENT_HTTP_RECV_BUF_SIZE
	int "HTTP receive buffer size"
	default 2048
	help
	  Size of the buffer the HTTP client parses into; body fragments are handed
	  to the sink straight out of it, so this is the per-chunk memory cost.

config OTA_CLIENT_HTTP_TIMEOUT_MS
	int "Timeout for the version probe (ms)"
	default 10000
	help
	  Budget for one whole HTTP exchange, as Zephyr's http_client_req() treats it
	  that way. The version file is a few bytes, so a stall here means the server
	  is not answering and the update should fail fast.

config OTA_CLIENT_HTTP_IMAGE_TIMEOUT_MS
	int "Timeout for the image download (ms)"
	default 300000
	help
	  Same kind of budget, for the image itself: a megabyte over a busy 2.4 GHz
	  link legitimately takes tens of seconds. Measured on an ESP32-C6 at ~100
	  kB/s, so 1 MB needs roughly 10 s of transfer plus flash writes; the default
	  leaves room for a much slower or noisier network.

endif # OTA_CLIENT_SOURCE_HTTP

config OTA_CLIENT_SINK_MCUBOOT
	bool "MCUboot image sink"
	default y
	# Select, do not depend: an application should get a working update path by
	# turning one knob. flash_img.c is built by IMG_MANAGER (MCUBOOT_IMG_MANAGER is
	# that menu's default choice, and it needs FLASH_MAP), while the activation and
	# confirmation calls come from bootutil via BOOTLOADER_MCUBOOT.
	select FLASH_MAP
	select STREAM_FLASH
	select IMG_MANAGER
	select BOOTLOADER_MCUBOOT
	help
	  Writes the incoming image into the secondary slot through Zephyr's
	  flash_img helper and asks MCUboot to swap it on the next reset. Also
	  provides the confirmation used to keep the new image once the device is
	  known healthy.

config OTA_CLIENT_THREAD
	bool "Provide a library worker thread"
	default n
	help
	  Runs ota_client_start()'s update on a dedicated thread, so a caller that
	  cannot block (a sensor or network thread) is not stuck for the length of
	  a download. Without this, call ota_client_update() from your own thread
	  or work queue and ota_client_start() returns -ENOSYS.

if OTA_CLIENT_THREAD

config OTA_CLIENT_THREAD_STACK_SIZE
	int "Worker thread stack size"
	default 4096

config OTA_CLIENT_THREAD_PRIORITY
	int "Worker thread priority (preemptive)"
	default 10

endif # OTA_CLIENT_THREAD

module = OTA_CLIENT
module-str = ota_client
source "subsys/logging/Kconfig.template.log_config"

endif # OTA_CLIENT
```
